## boards/shields/split_analog_pad/Kconfig.defconfig
```kconfig
if SHIELD_MY_KEYBOARD_RIGHT
config ZMK_SPLIT_ROLE_CENTRAL
    default y
config ZMK_KEYBOARD_NAME
    default "My Keyboard"
endif


if SHIELD_MY_KEYBOARD_LEFT
config ZMK_SPLIT_ROLE_CENTRAL
    default n
endif
if SHIELD_MY_KEYBOARD_LEFT || SHIELD_MY_KEYBOARD_RIGHT

config ZMK_SPLIT
    default y

endif
```

## boards/shields/split_analog_pad/Kconfig.shield
```kconfig
config SHIELD_MY_KEYBOARD_LEFT
    def_bool $(shields_list_contains,my_kb_left)

config SHIELD_MY_KEYBOARD_RIGHT
    def_bool $(shields_list_contains,my_kb_right)
```
